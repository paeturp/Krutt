## configs/pandaboard_krutt_defconfig
```kconfig
# Architecture
BR2_arm=y
BR2_cortex_a9=y

# system
BR2_TARGET_GENERIC_GETTY=y
BR2_TARGET_GENERIC_GETTY_PORT="ttyO2"
BR2_ROOTFS_DEVICE_CREATION_DYNAMIC_DEVTMPFS=y

# filesystem
BR2_TARGET_ROOTFS_TAR=y
BR2_TARGET_ROOTFS_TAR_NONE=y
BR2_TARGET_ROOTFS_TAR_OPTIONS=""

# Lock to 3.8 headers to avoid breaking with newer kernels
BR2_KERNEL_HEADERS_3_8=y

# Kernel
BR2_LINUX_KERNEL=y
BR2_LINUX_KERNEL_CUSTOM_VERSION=y
BR2_LINUX_KERNEL_CUSTOM_VERSION_VALUE="3.8.11"
BR2_LINUX_KERNEL_DEFCONFIG="omap2plus"

BR2_LINUX_KERNEL_PATCH="board/krutt/pandaboardesb1/linux"
BR2_LINUX_KERNEL_USE_CUSTOM_CONFIG=y
BR2_LINUX_KERNEL_CUSTOM_CONFIG_FILE="board/krutt/pandaboardesb1/linux/linux-3.8.11-krutt.config"

# Busybox 
BR2_PACKAGE_BUSYBOX_CONFIG="board/krutt/pandaboardesb1/busybox/busybox-1.21.0.config"

# Create custom directory on target
BR2_ROOTFS_OVERLAY="board/krutt/pandaboardesb1/fs-overlay"

# GCC
BR2_GCC_VERSION_4_6_X=y

# Bootloaders
BR2_TARGET_UBOOT=y
BR2_TARGET_UBOOT_FORMAT_IMG=y
BR2_TARGET_UBOOT_BOARDNAME="omap4_panda"
BR2_TARGET_UBOOT_SPL=y
BR2_TARGET_UBOOT_SPL_NAME="MLO"

#
# libnetfilter_queue requires a toolchain with LARGEFILE and IPv6 support
#
BR2_PACKAGE_LIBNL=y

#
# hplip requires a toolchain with C++ and thread support enabled
#
BR2_PACKAGE_DNSMASQ=y
BR2_PACKAGE_DNSMASQ_DHCP=y

#
# conntrack marking support requires a toolchain with LARGEFILE support
#
BR2_PACKAGE_DROPBEAR=y
BR2_PACKAGE_DROPBEAR_SMALL=y

#
# ipset requires a toolchain with LARGEFILE support
#
# BR2_PACKAGE_IPTABLES is not set
BR2_PACKAGE_IW=y

#
# Hardware handling
#

#
# Misc devices firmwares
#
# BR2_PACKAGE_B43_FIRMWARE is not set
# BR2_PACKAGE_FIRMWARE_IMX is not set
BR2_PACKAGE_LINUX_FIRMWARE=y

#
# WiFi firmwares
#
BR2_PACKAGE_LINUX_FIRMWARE_TI_WL127X=y

#
# gesftpserver requires a toolchain with WCHAR and threads support
#
BR2_PACKAGE_HOSTAPD=y
```
